## boards/shields/riry58/Kconfig.shield
```kconfig
# Copyright (c) 2020 Pete Johanson
# SPDX-License-Identifier: MIT

config SHIELD_RIRY58_LEFT
    def_bool $(shields_list_contains,riry58_left)

config SHIELD_RIRY58_RIGHT
    def_bool $(shields_list_contains,riry58_right)
```

## config/west.yml
```yaml
manifest:
  remotes:
    - name: zmkfirmware
      url-base: https://github.com/zmkfirmware
    # Additional modules containing boards/shields/custom code can be listed here as well
    # See https://docs.zephyrproject.org/3.2.0/develop/west/manifest.html#projects
  projects:
    - name: zmk
      remote: zmkfirmware
      revision: f92dce43e9c76bdba76359ec1f90e606cd609ee0 #main 28.07.2024
      import: app/west.yml
  self:
    path: config
```
